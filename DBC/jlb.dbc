VERSION ""

NS_ :

BS_:
BU_: JLB
BO_ 0 measurements-1: 8 JLB
   SG_ line-sensor-1 : 0|1@0+ (1,0) [0|1] "" JLB
   SG_ line-sensor-2 : 1|1@0+ (1,0) [0|1] "" JLB
   SG_ line-sensor-3 : 2|1@0+ (1,0) [0|1] "" JLB
   SG_ line-sensor-4 : 3|1@0+ (1,0) [0|1] "" JLB
   SG_ line-sensor-5 : 4|1@0+ (1,0) [0|1] "" JLB
   SG_ line-sensor-6 : 5|1@0+ (1,0) [0|1] "" JLB
   SG_ line-sensor-7 : 6|1@0+ (1,0) [0|1] "" JLB
   SG_ line-sensor-8 : 7|1@0+ (1,0) [0|1] "" JLB
   SG_ line-sensor-9 : 8|1@0+ (1,0) [0|1] "" JLB
   SG_ line-sensor-10 : 9|1@0+ (1,0) [0|1] "" JLB
   SG_ line-sensor-11 : 10|1@0+ (1,0) [0|1] "" JLB
   SG_ line-sensor-12 : 11|1@0+ (1,0) [0|1] "" JLB
   SG_ line-sensor-13 : 12|1@0+ (1,0) [0|1] "" JLB
   SG_ line-sensor-14 : 13|1@0+ (1,0) [0|1] "" JLB
   SG_ line-sensor-15 : 14|1@0+ (1,0) [0|1] "" JLB
   SG_ line-sensor-16 : 15|1@0+ (1,0) [0|1] "" JLB
   SG_ line-sensor-17 : 16|1@0+ (1,0) [0|1] "" JLB
   SG_ line-sensor-18 : 17|1@0+ (1,0) [0|1] "" JLB
   SG_ line-sensor-19 : 18|1@0+ (1,0) [0|1] "" JLB
   SG_ line-sensor-20 : 19|1@0+ (1,0) [0|1] "" JLB
   SG_ line-sensor-21 : 20|1@0+ (1,0) [0|1] "" JLB
   SG_ line-sensor-22 : 21|1@0+ (1,0) [0|1] "" JLB
   SG_ line-sensor-23 : 22|1@0+ (1,0) [0|1] "" JLB
   SG_ line-sensor-24 : 23|1@0+ (1,0) [0|1] "" JLB
   SG_ line-sensor-25 : 24|1@0+ (1,0) [0|1] "" JLB
   SG_ line-sensor-26 : 25|1@0+ (1,0) [0|1] "" JLB
   SG_ line-sensor-27 : 26|1@0+ (1,0) [0|1] "" JLB
   SG_ line-sensor-28 : 27|1@0+ (1,0) [0|1] "" JLB
   SG_ line-sensor-29 : 28|1@0+ (1,0) [0|1] "" JLB
   SG_ line-sensor-30 : 29|1@0+ (1,0) [0|1] "" JLB
   SG_ line-sensor-31 : 30|1@0+ (1,0) [0|1] "" JLB
   SG_ line-sensor-32 : 31|1@0+ (1,0) [0|1] "" JLB

BA_DEF_ BO_ "GenMsgBackgroundColor" STRING ;
BA_DEF_ BO_ "GenMsgForegroundColor" STRING ;
BA_DEF_ BO_ "filterlabeling" INT 0 0;
BA_DEF_DEF_ "GenMsgBackgroundColor" "#ffffff";
BA_DEF_DEF_ "GenMsgForegroundColor" "#000000";
BA_DEF_DEF_ "filterlabeling" 1;
